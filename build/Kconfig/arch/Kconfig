## build/Kconfig/arch/Kconfig
```kconfig
# Load Zephyr Arch Kconfig descriptions.
osource "C:/dev/stm32/zephyr/arch/rx/Kconfig"
osource "C:/dev/stm32/zephyr/arch/x86/Kconfig"
osource "C:/dev/stm32/zephyr/arch/xtensa/Kconfig"
osource "C:/dev/stm32/zephyr/arch/sparc/Kconfig"
osource "C:/dev/stm32/zephyr/arch/riscv/Kconfig"
osource "C:/dev/stm32/zephyr/arch/posix/Kconfig"
osource "C:/dev/stm32/zephyr/arch/mips/Kconfig"
osource "C:/dev/stm32/zephyr/arch/arm64/Kconfig"
osource "C:/dev/stm32/zephyr/arch/arm/Kconfig"
osource "C:/dev/stm32/zephyr/arch/arc/Kconfig"
```

## build/Kconfig/boards/Kconfig.defconfig
```kconfig
# Load Zephyr board defconfig descriptions.
osource "C:/dev/stm32/zephyr/boards/st/nucleo_u5a5zj_q/Kconfig.defconfig"
```

## build/Kconfig/boards/Kconfig.nucleo_u5a5zj_q
```kconfig
# Load board Kconfig descriptions.
osource "C:/dev/stm32/zephyr/boards/st/nucleo_u5a5zj_q/Kconfig.nucleo_u5a5zj_q"
```
